## arch/arm/soc/st_stm32/Kconfig.soc
```kconfig
# Kconfig - ST Microelectronics STM32 MCU line
#
# Copyright (c) 2016 Open-RnD Sp. z o.o.
#
# Licensed under the Apache License, Version 2.0 (the "License");
# you may not use this file except in compliance with the License.
# You may obtain a copy of the License at
#
#     http://www.apache.org/licenses/LICENSE-2.0
#
# Unless required by applicable law or agreed to in writing, software
# distributed under the License is distributed on an "AS IS" BASIS,
# WITHOUT WARRANTIES OR CONDITIONS OF ANY KIND, either express or implied.
# See the License for the specific language governing permissions and
# limitations under the License.
#

config SOC_STM32F1X
	bool "STM32F1x Series MCU"
	select CPU_CORTEX_M
	select CPU_CORTEX_M3
	select SOC_STM32
	help
	 Enable support for STM32F1 MCU series

config SOC_STM32F2X
	bool "STM32F2x Series MCU"
	select CPU_CORTEX_M
	select CPU_CORTEX_M3
	select SOC_STM32
	help
	 Enable support for STM32F2 MCU series

config SOC_STM32F3X
	bool "STM32F3x Series MCU"
	select CPU_CORTEX_M
	select CPU_CORTEX_M4
	select SOC_STM32
	help
	 Enable support for STM32F3 MCU series

config SOC_STM32F4X
	bool "STM32F4x Series MCU"
	select CPU_CORTEX_M
	select CPU_CORTEX_M4
	select SOC_STM32
	help
	 Enable support for STM32F4 MCU series
```

## arch/arm/soc/st_stm32/stm32f1/Kconfig.soc.family
```kconfig
choice
prompt "STM32F1x MCU Selection"
depends on SOC_STM32F1X

config SOC_STM32F103VE
       bool "STM32F103VE"

endchoice

if SOC_STM32F1X

source "arch/arm/soc/st_stm32/stm32f1/Kconfig.soc.stm32f1*"


config SOC
       default st_stm32/stm32f1

config SRAM_BASE_ADDRESS
        default 0x20000000

config FLASH_BASE_ADDRESS
        default 0x08000000

config NUM_IRQ_PRIO_BITS
        int
        default 3

config KERNEL_INIT_PRIORITY_DEFAULT
        default 40

config KERNEL_INIT_PRIORITY_DEVICE
        default 50

config UART_CONSOLE_PRIORITY
        default 60

if UART_CONSOLE

config UART_CONSOLE_ON_DEV_NAME
        default "UART_0"
config UART_CONSOLE_IRQ
        default 8
config UART_CONSOLE_IRQ_PRI
        default 3

endif # UART_CONSOLE

endif # SOC_STM32F1X
```

## arch/arm/soc/st_stm32/stm32f1/Kconfig.soc.stm32f103rb
```kconfig
if SOC_STM32F103RB

config SRAM_SIZE
       default 20

config FLASH_SIZE
       default 128

config NUM_IRQS
        int
        default 59

endif # SOC_STM32F103RB
```

## arch/arm/soc/st_stm32/stm32f1/Kconfig.soc.stm32f103ve
```kconfig
if SOC_STM32F103VE

config SRAM_SIZE
       default 64

config FLASH_SIZE
       default 512

config NUM_IRQS
        int
        default 68

endif # SOC_STM32F103VE
```

## arch/arm/soc/st_stm32/stm32f3/Kconfig.soc.family
```kconfig
# Kconfig - ST Microelectronics STM32F3 MCU line
#
# Copyright (c) 2016 Open-RnD Sp. z o.o.
#
# Licensed under the Apache License, Version 2.0 (the "License");
# you may not use this file except in compliance with the License.
# You may obtain a copy of the License at
#
#     http://www.apache.org/licenses/LICENSE-2.0
#
# Unless required by applicable law or agreed to in writing, software
# distributed under the License is distributed on an "AS IS" BASIS,
# WITHOUT WARRANTIES OR CONDITIONS OF ANY KIND, either express or implied.
# See the License for the specific language governing permissions and
# limitations under the License.
#

choice
prompt "STM32F3x MCU Selection"
depends on SOC_STM32F3X

config SOC_STM32F303VC
       bool "STM32F303VC"

config SOC_STM32F334R8
       bool "STM32F334R8"

endchoice

if SOC_STM32F3X

source "arch/arm/soc/st_stm32/stm32f3/Kconfig.soc.stm32f3*"


config SOC
       default st_stm32/stm32f3

config SRAM_BASE_ADDRESS
        default 0x20000000

config FLASH_BASE_ADDRESS
        default 0x08000000

config NUM_IRQ_PRIO_BITS
        int
        default 4

config KERNEL_INIT_PRIORITY_DEFAULT
        default 40

config KERNEL_INIT_PRIORITY_DEVICE
        default 50

config UART_CONSOLE_PRIORITY
        default 60

if UART_CONSOLE

config UART_CONSOLE_ON_DEV_NAME
        default "UART_0"

endif # UART_CONSOLE

endif # SOC_STM32F3X
```

## arch/arm/soc/stm32/Kconfig.soc
```kconfig
config SOC_STM32F1X
	bool "STM32F1x Series MCU"
        select CPU_CORTEX_M
	select CPU_CORTEX_M3

config SOC_STM32F2X
	bool "STM32F2x Series MCU"
        select CPU_CORTEX_M
	select CPU_CORTEX_M3

config SOC_STM32F3X
	bool "STM32F3x Series MCU"
        select CPU_CORTEX_M
	select CPU_CORTEX_M4

config SOC_STM32F4X
	bool "STM32F4x Series MCU"
        select CPU_CORTEX_M
	select CPU_CORTEX_M4
```

## arch/arm/soc/stm32f103ve/Kconfig.soc
```kconfig
config SOC_STM32F103VE
	bool "STM32F103VE Processor"
	select CPU_CORTEX_M
	select CPU_CORTEX_M3
```

## arch/arm/soc/stm32f103x/Kconfig
```kconfig
# Kconfig - Atmel SAM3 family processor configuration options

#
# Copyright (c) 2016 Intel Corporation.
# Copyright (c) 2014-2015 Wind River Systems, Inc.
#
# Licensed under the Apache License, Version 2.0 (the "License");
# you may not use this file except in compliance with the License.
# You may obtain a copy of the License at
#
#     http://www.apache.org/licenses/LICENSE-2.0
#
# Unless required by applicable law or agreed to in writing, software
# distributed under the License is distributed on an "AS IS" BASIS,
# WITHOUT WARRANTIES OR CONDITIONS OF ANY KIND, either express or implied.
# See the License for the specific language governing permissions and
# limitations under the License.
#

config SOC_STM32F10X
       bool
       select CLOCK_CONTROL
       select CLOCK_CONTROL_STM32F10X

choice
prompt "STM32F103x MCU Selection"
depends on SOC_STM32F103

source "arch/arm/soc/stm32f103x/Kconfig.soc.stm32f103*"

endchoice

if SOC_STM32F103

config SOC
       default stm32f103x

config SRAM_BASE_ADDRESS
        default 0x20000000

config FLASH_BASE_ADDRESS
        default 0x08000000

config NUM_IRQ_PRIO_BITS
        int
        default 3

config KERNEL_INIT_PRIORITY_DEFAULT
        default 40

config KERNEL_INIT_PRIORITY_DEVICE
        default 50

config UART_CONSOLE_PRIORITY
        default 60

if UART_CONSOLE

config UART_CONSOLE_ON_DEV_NAME
        default "UART_0"
config UART_CONSOLE_IRQ
        default 8
config UART_CONSOLE_IRQ_PRI
        default 3

endif # UART_CONSOLE

endif # SOC_STM32F103


if SOC_STM32F103VE

config SRAM_SIZE
       default 64

config FLASH_SIZE
       default 512

config NUM_IRQS
        int
        default 68

endif # SOC_STM32F103VE
```

## arch/arm/soc/stm32f103x/Kconfig.soc
```kconfig
config SOC_STM32F103
	bool "STM32F103x MCU Family"
	select CPU_CORTEX_M
	select CPU_CORTEX_M3
```

## boards/eb_stm32_06/Kconfig
```kconfig
if BOARD_EB_STM32_06

config BOARD
        default eb_stm32_06

endif # BOARD_EB_STM32_06
```

## boards/eb_stm32_06/Kconfig.board
```kconfig
config  BOARD_EB_STM32_06
        bool "EB STM32_06 Development Board"
        select SOC_STM32F103VE
	depends on ARM
```

## boards/eb_stm32_06/eb_stm32_06_defconfig
```kconfig
CONFIG_ARM=y
CONFIG_BOARD_BASIC_CORTEX_M3=y
CONFIG_SOC_STM32F103=y
CONFIG_SOC_STM32F103VE=y
CONFIG_UART_STM32F10X=y
CONFIG_UART_STM32F10X_BAUD_RATE=9600
CONFIG_SYS_CLOCK_HW_CYCLES_PER_SEC=36000000
# configure clocks to get 36MHz on APB1 and APB2
CONFIG_CLOCK_CONTROL_STM32F10X=y
CONFIG_CLOCK_STM32F10X_SYSCLK_SRC_PLL=y
CONFIG_CLOCK_STM32F10X_PLL_SRC_HSI=y
CONFIG_CLOCK_STM32F10X_PLL_MULTIPLIER=9
CONFIG_CLOCK_STM32F10X_AHB_PRESCALER=0
CONFIG_CLOCK_STM32F10X_APB1_PRESCALER=0
CONFIG_CLOCK_STM32F10X_APB2_PRESCALER=0
CONFIG_CONSOLE=y
CONFIG_UART_CONSOLE=y
CONFIG_SERIAL=y
CONFIG_CORTEX_M_SYSTICK=y
```

## boards/stm32_mini_a15/Kconfig
```kconfig
if BOARD_STM32_MINI_A15

config BOARD
	default stm32_mini_a15

endif # BOARD_STM32_MINI_A15
```

## boards/stm32_mini_a15/Kconfig.board
```kconfig
config  BOARD_STM32_MINI_A15
	bool "STM32 MINI A15 Development Board"
        select SOC_STM32F103VE
	depends on ARM
```

## drivers/clock_control/Kconfig.stm32f10x
```kconfig
config CLOCK_CONTROL_STM32F10X
       bool
       prompt "STM32F10x Reset & Clock Control"
       depends on CLOCK_CONTROL && SOC_STM32F10X
       default y if SOC_STM32F10X

choice
prompt "STM32F10x System Clock Source"
depends on CLOCK_CONTROL_STM32F10X

config CLOCK_STM32F10X_SYSCLK_SRC_HSI
       bool "HSI"

config CLOCK_STM32F10X_SYSCLK_SRC_HSE
       bool "HSE"

config CLOCK_STM32F10X_SYSCLK_SRC_PLL
       bool "PLL"

endchoice

choice
prompt "STM32F10x PLL Clock Source"
depends on CLOCK_CONTROL_STM32F10X

config CLOCK_STM32F10X_PLL_SRC_HSI
       bool "HSI"

config CLOCK_STM32F10X_PLL_SRC_PREDIV1
       bool "PREDIV1"

endchoice

config CLOCK_STM32F10X_PLL_MULTIPLIER
       int "PLL multiplier"
       depends on CLOCK_CONTROL_STM32F10X
       help
        PLL multiplier, allowed values: 4, 5, 6, 7, 8, 9, and 65.
        Value 65 maps to 6.5x multiplier.

config CLOCK_STM32F10X_AHB_PRESCALER
       int "AHB prescaler"
       depends on CLOCK_CONTROL_STM32F10X
       help
        AHB prescaler, allowed values: 0, 2, 4, 7, 16, 64, 128,
        256, 512.

config CLOCK_STM32F10X_APB1_PRESCALER
       int "APB1 prescaler"
       depends on CLOCK_CONTROL_STM32F10X
       help
        APB1 Low speed clock (PCLK1) prescaler, allowed values:
        2, 4, 8, 16

config CLOCK_STM32F10X_APB2_PRESCALER
       int "APB2 prescaler"
       depends on CLOCK_CONTROL_STM32F10X
       help
        APB2 High speed clock (PCLK2) prescaler, allowed values:
        2, 4, 8, 16
```

## drivers/gpio/Kconfig.stm32f10x
```kconfig
config GPIO_STM32F10X
	bool "GPIO Driver for STM32F10x family of MCUs"
	depends on GPIO && SOC_STM32F1X
	default n
	help
         Enable GPIO driver for STM32F10x line of MCUs

config GPIO_STM32F10X_PORTA
	bool "Enable GPIO port A support"
	depends on GPIO && GPIO_STM32F10X
	default n

config GPIO_STM32F10X_PORTB
	bool "Enable GPIO port B support"
	depends on GPIO && GPIO_STM32F10X
	default n

config GPIO_STM32F10X_PORTC
	bool "Enable GPIO port C support"
	depends on GPIO && GPIO_STM32F10X
	default n

config GPIO_STM32F10X_PORTD
	bool "Enable GPIO port D support"
	depends on GPIO && GPIO_STM32F10X
	default n

config GPIO_STM32F10X_PORTE
	bool "Enable GPIO port E support"
	depends on GPIO && GPIO_STM32F10X
	default n

config GPIO_STM32F10X_PORTF
	bool "Enable GPIO port F support"
	depends on GPIO && GPIO_STM32F10X
	default n

config GPIO_STM32F10X_PORTG
	bool "Enable GPIO port G support"
	depends on GPIO && GPIO_STM32F10X
	default n
```

## drivers/pinmux/Kconfig.stm32f10x
```kconfig
config PINMUX_STM32F10X
       bool "Pinmux driver for STM32F10x MCUs"
       depends on PINMUX && SOC_STM32F1X
```

## drivers/serial/Kconfig.stm32
```kconfig
# Kconfig - STM32 UART configuration
#
# Copyright (c) 2016 Open-RnD Sp. z o.o.
#
# Licensed under the Apache License, Version 2.0 (the "License");
# you may not use this file except in compliance with the License.
# You may obtain a copy of the License at
#
#     http://www.apache.org/licenses/LICENSE-2.0
#
# Unless required by applicable law or agreed to in writing, software
# distributed under the License is distributed on an "AS IS" BASIS,
# WITHOUT WARRANTIES OR CONDITIONS OF ANY KIND, either express or implied.
# See the License for the specific language governing permissions and
# limitations under the License.
#

menuconfig UART_STM32
	bool "STM32 MCU serial driver"
	default n
	select SERIAL_HAS_DRIVER
	depends on SOC_STM32
	help
	  This option enables the UART driver for STM32F10x family of
	  processors. Say y if you wish to use serial port on STM32F10x
	  MCU.

# --- port 0 ---

config UART_STM32_PORT_0
	bool "Enable STM32 USART1 Port "
	default n
	depends on UART_STM32
	help
	  Enable support for USART1 port in the driver. Say y here
	  if you want to use USART1 device.

config UART_STM32_PORT_0_NAME
	string "Device Name for STM32 USART1 Port"
	default "UART_0"
	depends on UART_STM32_PORT_0
	help
	  This is the device name for USART1 port, and is
	  included in the device struct.

config UART_STM32_PORT_0_BAUD_RATE
	int "STM32 USART1 Baud Rate"
	default 9600
	depends on UART_STM32_PORT_0
	help
	  The baud rate for USART1 port to be set to at boot.
```

## drivers/serial/Kconfig.stm32f10x
```kconfig
config UART_STM32F10X
	bool "STM32F10x family UART Driver"
	default n
	select SERIAL_HAS_DRIVER
	depends on SOC_STM32F1X
	help
	This option enables the UART driver for STM32F10x family of
        processors.

config UART_STM32F10X_NAME
	string "Device Name for STM32F10x UART"
	default "UART_0"
	depends on UART_STM32F10X
	help
	  This is the device name for UART, and is included in the device
	  struct.

config UART_STM32F10X_BAUD_RATE
	int "STM32F10x UART Baud Rate"
	default 115200
	depends on UART_STM32F10X
	help
	  The baud rate for UART port to be set to at boot.

config UART_STM32F10X_CLK_FREQ
	int "STM32F10x UART Clock Frequency"
	default 0
	depends on UART_STM32F10X
	help
	  The clock frequency for UART port.
```
